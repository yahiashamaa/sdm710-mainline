// SPDX-License-Identifier: GPL-2.0-only
/*
 * Device tree for Google Pixel 3a (non-XL).
 *
 * Copyright (c) 2023, Richard Acayan. All rights reserved.
 */

/dts-v1/;

#include "sdm670-google-common.dtsi"

/ {
	model = "Google Pixel 3a";
	compatible = "google,sargo", "qcom,sdm670";
};

&framebuffer {
	reg = <0 0x9c000000 0 (1080 * 2220 * 4)>;
	width = <1080>;
	height = <2220>;
	stride = <(1080 * 4)>;
	status = "okay";
};

&panel {
	compatible = "samsung,s6e3fa7-ams559nk06";
	status = "okay";
};

&rmi4_f12 {
	touchscreen-x-mm = <63>;
	touchscreen-y-mm = <127>;
};
